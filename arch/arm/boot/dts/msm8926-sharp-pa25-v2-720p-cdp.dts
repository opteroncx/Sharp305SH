/* Copyright (c) 2013-2014, The Linux Foundation. All rights reserved.
 *
 * This program is free software; you can redistribute it and/or modify
 * it under the terms of the GNU General Public License version 2 and
 * only version 2 as published by the Free Software Foundation.
 *
 * This program is distributed in the hope that it will be useful,
 * but WITHOUT ANY WARRANTY; without even the implied warranty of
 * MERCHANTABILITY or FITNESS FOR A PARTICULAR PURPOSE.  See the
 * GNU General Public License for more details.
 */


/dts-v1/;
/include/ "msm8926-v2.dtsi"
/include/ "sharp-common.dtsi"
/include/ "sharp-pa25-720p.dtsi"
/include/ "sharp-pa25-camera-sensor-cdp.dtsi"

/ {
	model = "sharp pa25";
	compatible = "qcom,sharp-pa25", "qcom,msm8926", "qcom,cdp";
	qcom,board-id = <65 0>;
};

&pm8226_chg {
	status = "ok";
};

&smsc_hub {
	status = "ok";
};
