## drivers/sharp/Kconfig
```kconfig
#
# SHARP configuration
#

menu "SHARP Device Drivers"

source "drivers/sharp/shdiag/Kconfig"
source "drivers/sharp/mfc/Kconfig"
#CONFIG_SH_AUDIO_DRIVER -> 13-007
source "drivers/sharp/shaudio/Kconfig"
#CONFIG_SH_AUDIO_DRIVER <- 13-007
source "drivers/sharp/shbatt/Kconfig"
source "drivers/sharp/wifi/Kconfig"
source "drivers/sharp/shlog/Kconfig"
source "drivers/sharp/shmds/Kconfig"
source "drivers/sharp/proximity/Kconfig"
source "drivers/sharp/shterm/Kconfig"
source "drivers/sharp/shtps/Kconfig"
source "drivers/sharp/vold/Kconfig"
source "drivers/sharp/shtimer/Kconfig"
source "drivers/sharp/shcamled/Kconfig"
source "drivers/sharp/shsensor_hub/ml630q790/Kconfig"
source "drivers/sharp/tunerdrv/Kconfig"
endmenu
```

## drivers/sharp/shmds/Kconfig
```kconfig
menuconfig SHMDS
	bool "Motion Sensor Drivers"
	default y

if SHMDS
source "drivers/sharp/shmds/motionsensor/Kconfig"

endif
```

## drivers/sharp/shmds/motionsensor/Kconfig
```kconfig
#
# Motion sensors
#
menu "Motion sensors"

config SENSORS_AKM8963
	tristate "Asahi Kasei AKM8963 3-Axis Magnetometer"
	depends on I2C
	depends on GENERIC_GPIO
	help
	  Say yes here to build support for Asahi Kasei AKM8963 3-Axis
	  Magnetometer.

	  To compile this driver as a module, choose M here: the module
	  will be called akm8963.


config SENSORS_LIS2DH
	tristate "STMicroelectronics LIS2DH 3-Axis Accelerometer"
	depends on I2C
	depends on GENERIC_GPIO
	help
	  Say yes here to build support for STMicroelectronics  LIS2DH 3-Axis
	  Accelerometer.

	  To compile this driver as a module, choose M here: the module
	  will be called lis2dh_acc.

endmenu
```

## drivers/sharp/shtps/sy3000/Kconfig
```kconfig
#
# Sharp Touchscreen configuration
#

if TOUCHSCREEN_SHTPS

	config SHTPS_SY3X00_DEV
		tristate "SY3x00 Device"
		default n
		depends on TOUCHSCREEN_SHTPS

	config SHTPS_SY3000_TM2949_001
		tristate "SY3000 TM2949-001"
		default n
		depends on SHTPS_SY3X00_DEV

	config SHTPS_SY3000_PLG500_001
		tristate "SY3000 PLG500-001"
		default n
		depends on SHTPS_SY3X00_DEV

endif # TOUCHSCREEN_SHTPS
```
